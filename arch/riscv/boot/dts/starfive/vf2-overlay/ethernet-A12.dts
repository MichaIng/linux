/dts-v1/;
/plugin/;
/ {
	compatible = "starfive,visionfive-v2", "starfive,jh7110";
	fragment@0 {
		target-path = "/soc/ethernet@16030000/ethernet-phy@0";
		__overlay__ {
			tx_delay_sel = <0x9>;
			tx_inverted_10 = <0x0>;
			tx_inverted_100 = <0x0>;
			tx_inverted_1000 = <0x0>;
		};
	};
	fragment@1 {
		target-path = "/soc/ethernet@16040000/ethernet-phy@1";
		__overlay__ {
			tx_delay_sel = <0x9>;
			tx_inverted_10 = <0x0>;
			tx_inverted_100 = <0x0>;
			tx_inverted_1000 = <0x0>;
		};
	};
};
